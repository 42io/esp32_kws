## 2-mfcc-nn-streaming/components/kws/Kconfig.projbuild
```kconfig
menu "KWS"

choice
    prompt "KWS LANGUGE"
    default KWS_LANG_EN

config KWS_LANG_EN
    bool "en"
endchoice

config KWS_GUESS_MODEL_START
    string
    default "_binary_dcnn_en_tflite_start" if KWS_LANG_EN

config KWS_GUESS_MODEL_OUT_NUM
    int
    default 12

config KWS_GUESS_TENSOR_ARENA_SZ
    int
    default 18048

choice
    prompt "The cpu core which kws run"
    default KWS_PINNED_TO_CORE_1
    config KWS_PINNED_TO_CORE_0
        bool "Core 0 (PRO CPU)"
    config KWS_PINNED_TO_CORE_1
        bool "Core 1 (APP CPU)"
endchoice

config KWS_PINNED_TO_CORE
    int
    default 0 if KWS_PINNED_TO_CORE_0
    default 1 if KWS_PINNED_TO_CORE_1

config KWS_CONFIRM_MODEL_START
    string
    default "_binary_dcnn_en_bin_tflite_start" if KWS_LANG_EN

config KWS_CONFIRM_TENSOR_ARENA_SZ
    int
    default 10568

config KWS_CONFIRM_THRESHOLD
    int
    default 5

choice
    prompt "The cpu core which confirm run"
    default KWS_CONFIRM_PINNED_TO_CORE_0
    config KWS_CONFIRM_PINNED_TO_CORE_0
        bool "Core 0 (PRO CPU)"
    config KWS_CONFIRM_PINNED_TO_CORE_1
        bool "Core 1 (APP CPU)"
endchoice

config KWS_CONFIRM_PINNED_TO_CORE
    int
    default 0 if KWS_CONFIRM_PINNED_TO_CORE_0
    default 1 if KWS_CONFIRM_PINNED_TO_CORE_1

endmenu
```

## mfcc-nn-streaming/components/kws/Kconfig.projbuild
```kconfig
menu "KWS"

choice
    prompt "KWS LANGUGE"
    default KWS_LANG_EN

config KWS_LANG_RU
    bool "ru"

config KWS_LANG_EN
    bool "en"
endchoice

config KWS_MODEL_START
    string
    default "_binary_dcnn_en_tflite_start" if KWS_LANG_EN
    default "_binary_dcnn_ru_tflite_start" if KWS_LANG_RU

config KWS_MODEL_OUT_NUM
    int
    default 12

config KWS_TENSOR_ARENA_SZ
    int
    default 18048

endmenu
```

## rt/sdkconfig.defaults
```kconfig
CONFIG_PARTITION_TABLE_CUSTOM=y
CONFIG_PARTITION_TABLE_CUSTOM_FILENAME="partitions.csv"

CONFIG_ESP32_DEFAULT_CPU_FREQ_240=y

CONFIG_ESP_LYRATD_MSC_V2_1_BOARD=y

CONFIG_ESPTOOLPY_BAUD_921600B=y
CONFIG_ESPTOOLPY_FLASHSIZE_4MB=y

CONFIG_HEAP_POISONING_DISABLED=y
CONFIG_STACK_CHECK_NONE=y
CONFIG_OPTIMIZATION_LEVEL_RELEASE=y
CONFIG_ESP32_PANIC_PRINT_REBOOT=y
```

## sdkconfig.defaults
```kconfig
CONFIG_PARTITION_TABLE_CUSTOM=y
CONFIG_PARTITION_TABLE_CUSTOM_FILENAME="partitions.csv"
CONFIG_ESPTOOLPY_FLASHSIZE_8MB=y

CONFIG_ESP32_DEFAULT_CPU_FREQ_240=y
CONFIG_SPIRAM_SUPPORT=y
CONFIG_SPIRAM_USE_MALLOC=y

CONFIG_ESPTOOLPY_BAUD_921600B=y
```

## vad/components/kws/Kconfig
```kconfig
menu "c_keyword_spotting"

config KWS_VAD_VOICED_THOLD
    int "VAD Voiced Threshold"
    range 1 20
    default 5

choice KWS_MODEL_TYPE
    prompt "Neural Network Type"
    default KWS_MODEL_TYPE_RNN
    help
        Select neural network model to use

config KWS_MODEL_TYPE_RNN
    bool "Recurrent"
config KWS_MODEL_TYPE_CNN
    bool "Convolutional"
config KWS_MODEL_TYPE_MLP
    bool "Multilayer Perceptron"
endchoice

config KWS_DUMP_AUDIO_SAMPLE_TO_LOG
    bool "Dump audio sample to log in base64 format"
    default N

endmenu
```

## vad/components/kws/Kconfig.projbuild
```kconfig
menu "VAD_KWS"

config KWS_VAD_VOICED_THOLD
    int "VAD Voiced Threshold"
    range 1 20
    default 5

choice KWS_PLATFORM_TYPE
    prompt "Neural Network Type"
    default KWS_PLATFORM_TYPE_TF
    help
        Select platform to use

config KWS_PLATFORM_TYPE_TF
    bool "Tensorflow micro"
config KWS_PLATFORM_TYPE_KANN
    bool "KANN attractivechaos"
endchoice

choice KWS_MODEL_TYPE
    prompt "Neural Network Type"
    help
        Select neural network model to use

config KWS_MODEL_TYPE_DCNN
    depends on KWS_PLATFORM_TYPE_TF
    bool "Depthwise separable convolution"
config KWS_MODEL_TYPE_RNN
    depends on KWS_PLATFORM_TYPE_KANN
    bool "Recurrent"
config KWS_MODEL_TYPE_CNN
    bool "Convolutional"
config KWS_MODEL_TYPE_MLP
    bool "Multilayer Perceptron"
endchoice

config KWS_DUMP_AUDIO_SAMPLE_TO_LOG
    bool "Dump audio sample to log in base64 format"
    default N

endmenu
```
